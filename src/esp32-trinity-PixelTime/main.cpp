#include <ESP32-HUB75-MatrixPanel-I2S-DMA.h>

/*--------------------- MATRIX GPIO CONFIG  -------------------------*/
#define R1_PIN 25
#define G1_PIN 26
#define B1_PIN 27
#define R2_PIN 14
#define G2_PIN 12
#define B2_PIN 13
#define A_PIN 23
#define B_PIN 19
#define C_PIN 5
#define D_PIN 17
#define E_PIN 18 // Needed fo 64x64. This is the only change from the default pins of the library
#define LAT_PIN 4
#define OE_PIN 15
#define CLK_PIN 16

/*--------------------- MATRIX PANEL CONFIG -------------------------*/
const int panelResX = 64;  // Number of pixels wide of each INDIVIDUAL panel module.
const int panelResY = 64;  // Number of pixels tall of each INDIVIDUAL panel module.
const int panel_chain = 1; // Total number of panels chained one to another

// Note about chaining panels:
// By default all matrix libraries treat the panels as been connected horizontally
// (one long display). The I2S Matrix library supports different display configurations
// Details here:

// See the setup method for more display config options

//------------------------------------------------------------------------------------------------------------------

MatrixPanel_I2S_DMA *dma_display = nullptr;

// Some standard colors
uint16_t myRED = dma_display->color565(255, 0, 0);
uint16_t myGREEN = dma_display->color565(0, 255, 0);
uint16_t myBLUE = dma_display->color565(0, 0, 255);
uint16_t myWHITE = dma_display->color565(255, 255, 255);
uint16_t myYELLOW = dma_display->color565(255, 255, 0);
uint16_t myCYAN = dma_display->color565(0, 255, 255);
uint16_t myMAGENTA = dma_display->color565(255, 0, 255);
uint16_t myBLACK = dma_display->color565(0, 0, 0);

#define matrix_width panelResX
#define matrix_height panelResY

// This defines the 'on' time of the display is us. The larger this number,
// the brighter the display. If too large the ESP will crash
// uint8_t display_draw_time = 10; // 30-70 is usually fine

void displaySetup()
{
  HUB75_I2S_CFG mxconfig(
      panelResX,  // module width
      panelResY,  // module height
      panel_chain // Chain length
  );

  // This is how you enable the double buffer.
  // Double buffer can help with animation heavy projects
  // It's not needed for something simple like this, but some
  // of the other examples make use of it.

  // mxconfig.double_buff = true;

  // If you are using a 64x64 matrix you need to pass a value for the E pin
  // The trinity connects GPIO 18 to E.
  // This can be commented out for any smaller displays (but should work fine with it)
  mxconfig.gpio.e = 18;

  // May or may not be needed depending on your matrix
  // Example of what needing it looks like:
  // https://github.com/mrfaptastic/ESP32-HUB75-MatrixPanel-I2S-DMA/issues/134#issuecomment-866367216
  mxconfig.clkphase = false;

  // Some matrix panels use different ICs for driving them and some of them have strange quirks.
  // If the display is not working right, try this.
  // mxconfig.driver = HUB75_I2S_CFG::FM6126A;

  // Display Setup
  dma_display = new MatrixPanel_I2S_DMA(mxconfig);
  dma_display->begin();
}

uint16_t myCOLORS[8] = {myRED, myGREEN, myBLUE, myWHITE, myYELLOW, myCYAN, myMAGENTA, myBLACK};

uint8_t static weather_icons[] = {0x00, 0x00, 0x00, 0x00, 0x00, 0x00, 0x00, 0x20, 0x00, 0x00, 0x00, 0x00, 0x00,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 0x00, 0x00};

void setup()
{
  Serial.begin(115200);

  displaySetup();

  dma_display->clearScreen();
  dma_display->setTextColor(myCYAN);
  dma_display->setCursor(2, 0);
  dma_display->print("Pixel");
  dma_display->setTextColor(myMAGENTA);
  dma_display->setCursor(2, 8);
  dma_display->print("Time");

  delay(3000);
}
union single_double
{
  uint8_t two[2];
  uint16_t one;
} this_single_double;

// This draws the weather icons
void draw_weather_icon(uint8_t icon)
{
  if (icon > 10)
    icon = 10;
  for (int yy = 0; yy < 10; yy++)
  {
    for (int xx = 0; xx < 10; xx++)
    {
      uint16_t byte_pos = (xx + icon * 10) * 2 + yy * 220;
      this_single_double.two[1] = weather_icons[byte_pos];
      this_single_double.two[0] = weather_icons[byte_pos + 1];
      dma_display->drawPixel(1 + xx, yy, this_single_double.one);
    }
  }
}

unsigned long last_draw = 0;
void scroll_text(uint8_t ypos, unsigned long scroll_delay, String text, uint8_t colorR, uint8_t colorG, uint8_t colorB)
{
  uint16_t text_length = text.length();
  dma_display->setTextWrap(false); // we don't wrap text so it scrolls nicely
  dma_display->setTextSize(1);
  dma_display->setRotation(0);
  dma_display->setTextColor(dma_display->color565(colorR, colorG, colorB));

  // Asuming 5 pixel average character width
  for (int xpos = matrix_width; xpos > -(matrix_width + text_length * 5); xpos--)
  {
    dma_display->setTextColor(dma_display->color565(colorR, colorG, colorB));
    dma_display->clearScreen();
    dma_display->setCursor(xpos, ypos);
    dma_display->println(text);
    delay(scroll_delay);
    yield();

    // This might smooth the transition a bit if we go slow
    // dma_display->setTextColor(dma_display->color565(colorR/4,colorG/4,colorB/4));
    // dma_display->setCursor(xpos-1,ypos);
    // dma_display->println(text);

    delay(scroll_delay / 5);
    yield();
  }
}

uint8_t icon_index = 0;
void loop()
{
  scroll_text(1, 50, "Welcome to MatrixPanel!", 96, 96, 250);
  dma_display->clearScreen();

  draw_weather_icon(icon_index);
  icon_index++;
  if (icon_index > 10)
    icon_index = 0;

  for (int xx = 0; xx < 16; xx++)
  {
    dma_display->drawLine(xx + 16, 0, xx + 16, 5, dma_display->color565(xx * 16, 0, 0));
    dma_display->drawLine(xx + 16, 6, xx + 16, 10, dma_display->color565(0, xx * 16, 0));
    dma_display->drawLine(xx + 16, 11, xx + 16, 15, dma_display->color565(0, 0, xx * 16));
  }
  delay(1000);
  for (uint8_t dimm = 255; dimm > 0; dimm--)
  {
    dma_display->setBrightness(dimm);
    delay(5);
  }
  for (uint8_t dimm = 0; dimm < 255; dimm++)
  {
    dma_display->setBrightness(dimm);
    delay(5);
  }
}
